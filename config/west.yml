## config/west.yml
```yaml
manifest:
  remotes:
    - name: willelind
      url-base: https://github.com/willelind
  projects:
    - name: zmk
      remote: willelind
      revision: bluetooth-feature
      import: app/west.yml
  self:
    path: config
```
